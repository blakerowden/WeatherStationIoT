## CMakeLists.txt
```
# SPDX-License-Identifier: Apache-2.0

set(BOARD nrf52840dongle_nrf52840)
set(CONF_FILE prj.conf bt.conf usb.conf shell.conf)
set(DTC_OVERLAY_FILE dtc_shell.overlay)

cmake_minimum_required(VERSION 3.20.0)
find_package(Zephyr REQUIRED HINTS $ENV{ZEPHYR_BASE})
project(ahu)

#Add Include Directories
include_directories(
                        ../../oslib/ahu_drivers/ahu_ble
                        ../../oslib/ahu_drivers/ahu_shell
                        ../../oslib/ahu_drivers/ahu_data
                        ../../oslib/common
                        )

#Add Target Sources
target_sources(app PRIVATE
                        ../../oslib/ahu_drivers/ahu_ble/ble_base.c
                        ../../oslib/ahu_drivers/ahu_data/ahu_data.c
                        ../../oslib/ahu_drivers/ahu_shell/shell_base.c
                        ../../oslib/ahu_drivers/ahu_shell/shell_led.c
                        ../../oslib/ahu_drivers/ahu_shell/shell_time.c
                        ../../oslib/ahu_drivers/ahu_shell/shell_scu.c
                        ../../oslib/common/led_driver.c
                        ../../oslib/common/hci_driver.c
                        ../../oslib/common/pb_driver.c
                        src/main.c
                        )

zephyr_library_include_directories(${ZEPHYR_BASE}/samples/bluetooth)
```

## prj.conf
```kconfig
CONFIG_GPIO=y

#------------------------------ENABLE USB---------------------------------------
#Add this line if building for the Arduino Sense Board
CONFIG_USB_DEVICE_STACK=y
CONFIG_USB_DEVICE_PRODUCT="nRF Dongle"

CONFIG_SERIAL=y
CONFIG_UART_LINE_CTRL=y
CONFIG_USB_UART_CONSOLE=y
#-------------------------------------------------------------------------------
```

## bt.conf
```kconfig
#------------------------------------------------------------------------------
                                #BT Config
#------------------------------------------------------------------------------
#BT On
CONFIG_BT=y
#Become an observer 
CONFIG_BT_OBSERVER=y
#BT Log Level Debug
CONFIG_BT_DEBUG_LOG=y

CONFIG_BT_DEVICE_NAME="Weather Station - Application Host Unit"
#Enable support for the Security Manager Protocol (SMP), making it possible to pair devices over LE.
CONFIG_BT_SMP=y
#Enable data signing which is used for transferring authenticated data in an unencrypted connection.
CONFIG_BT_SIGNING=y
#Select this for LE Central role support
CONFIG_BT_CENTRAL=y
#Enable GATT Device Information service
CONFIG_BT_DIS=y
#Enabled Client procedures 
CONFIG_BT_GATT_CLIENT=y
#Enable local Privacy Feature support. This makes it possible to use Resolvable Private Addresses (RPAs).
CONFIG_BT_PRIVACY=y
#Bluetooth device appearance. 
CONFIG_BT_DEVICE_APPEARANCE=833
# Set the BLE to transmit with +4dbm power
CONFIG_BT_CTLR_TX_PWR_PLUS_8=y

CONFIG_BT_CONN_TX_MAX=16
#CONFIG_BT_CTLR_TX_BUFFERS=16
```

## shell.conf
```kconfig
#-----------------------------SHELL_CONF--------------------------------------
CONFIG_SHELL_BACKEND_SERIAL_CHECK_DTR=y
CONFIG_UART_LINE_CTRL=y
CONFIG_SHELL_BACKEND_SERIAL_INIT_PRIORITY=51
CONFIG_SHELL=y
CONFIG_SHELL_BACKENDS=y
CONFIG_SHELL_BACKEND_SERIAL=y

CONFIG_SHELL_PROMPT_UART="WeatherStationAHU:~$"

CONFIG_SHELL_CMDS=y
CONFIG_SHELL_TAB=y
CONFIG_SHELL_TAB_AUTOCOMPLETION=y
CONFIG_SHELL_VT100_COLORS=y
CONFIG_KERNEL_SHELL=y
#-----------------------------------------------------------------------------

#-----------------------------SHELL_LOGGING-----------------------------------
CONFIG_LOG=y
CONFIG_LOG_PRINTK=y
#-----------------------------------------------------------------------------
```

## usb.conf
```kconfig
#----------------------------------USB SETUP----------------------------------
CONFIG_USB_DEVICE_STACK=y
#-----------------------------------------------------------------------------

#--------------------------------USB_OPTIONS----------------------------------
CONFIG_USB_DEVICE_PRODUCT="Weather Station - Application Host Unit"
CONFIG_USB_DEVICE_MANUFACTURER="Blake Rowden"
CONFIG_USB_DEVICE_VID=0xC553
CONFIG_USB_DEVICE_PID=0x4011

CONFIG_SERIAL=y
CONFIG_UART_LINE_CTRL=y
#-----------------------------------------------------------------------------
```

## src/main.c
```c
/**
 * @file main.c
 * @author Blake Rowden (b.rowden@uqconnect.edu.au) - s4427634
 * @brief Weather Station - Application Host Unit
 * @version 0.2
 * @date 2022-03-15
 *
 * @copyright Copyright (c) 2022
 *
 */

#include <zephyr/types.h>
#include <stddef.h>
#include <errno.h>
#include <zephyr.h>
#include <sys/printk.h>
#include <device.h>
#include <devicetree.h>
#include <logging/log.h>

#include "led_driver.h"
#include "shell_base.h"
#include "shell_time.h"
#include "shell_led.h"
#include "shell_scu.h"
#include "ble_base.h"
#include "pb_driver.h"
#include "ahu_data.h"

// Debug Settings ==============================================================
#define DEBUG_BLE_LED 0

// Logging Module ==============================================================
LOG_MODULE_REGISTER(log_main);

// Functions ===================================================================

/**
 * @brief Initialises the hardware and shell
 *
 */
void initialise(void)
{

        init_leds();
        setup_pb();
        begin_shell();
}

void main(void)
{

        initialise();
}

// Thread Defines ==============================================================

// START BLE BASE entry thread : Delayed Start (Wait for USB to be ready)
K_THREAD_DEFINE(ble_base, THREAD_BLE_BASE_STACK, thread_ble_base, NULL, NULL, NULL, THREAD_PRIORITY_BLE_BASE, 0, 0);
K_THREAD_DEFINE(rx_data, THREAD_BLE_BASE_STACK, process_rx_data, NULL, NULL, NULL, THREAD_PRIORITY_BLE_BASE, 0, 0);
K_THREAD_DEFINE(ahu_data_thread, THREAD_BLE_BASE_STACK, JSON_thread, NULL, NULL, NULL, THREAD_PRIORITY_BLE_BASE, 0, 0);
// Start BLE LED Thread
#if DEBUG_BLE_LED
K_THREAD_DEFINE(ble_led, THREAD_BLE_LED_STACK, thread_ble_led, NULL, NULL, NULL, THREAD_PRIORITY_BLE_LED, 0, 0);
#endif

// Shell Commands ==============================================================

// Level 2 //
SHELL_STATIC_SUBCMD_SET_CREATE(hts221_read,
                               SHELL_CMD(t, NULL, "Read the temperature", cmd_hts221_read_temp),
                               SHELL_CMD(h, NULL, "Read the humidity", cmd_hts221_read_hum),
                               SHELL_SUBCMD_SET_END);

SHELL_STATIC_SUBCMD_SET_CREATE(lis2dh_read,
                               SHELL_CMD(x, NULL, "Read the X-Axis", cmd_lis2dh_read_x),
                               SHELL_CMD(y, NULL, "Read the Y-Axis", cmd_lis2dh_read_y),
                               SHELL_CMD(z, NULL, "Read the Z-Axis", cmd_lis2dh_read_z),
                               SHELL_SUBCMD_SET_END);

// Level 1 //
SHELL_STATIC_SUBCMD_SET_CREATE(time_read,
                               SHELL_CMD(f, NULL, "Show the time formatted as hours, minutes, seconds..", cmd_disp_format_time),
                               SHELL_SUBCMD_SET_END);

SHELL_STATIC_SUBCMD_SET_CREATE(hts221_readwrite,
                               SHELL_CMD(r, &hts221_read, "Read", NULL),
                               SHELL_SUBCMD_SET_END);

SHELL_STATIC_SUBCMD_SET_CREATE(lps22_readwrite,
                               SHELL_CMD(r, NULL, "Read Pressure", cmd_lps22_read_pres),
                               SHELL_SUBCMD_SET_END);

SHELL_STATIC_SUBCMD_SET_CREATE(ccs811_readwrite,
                               SHELL_CMD(r, NULL, "Read VOC", cmd_ccs811_read_voc),
                               SHELL_SUBCMD_SET_END);

SHELL_STATIC_SUBCMD_SET_CREATE(lis2dh_readwrite,
                               SHELL_CMD(r, &lis2dh_read, "Read", NULL),
                               SHELL_SUBCMD_SET_END);

SHELL_STATIC_SUBCMD_SET_CREATE(buzzer_readwrite,
                               SHELL_CMD(w, NULL, "Write Frequency <freq>", cmd_buzzer_write_freq),
                               SHELL_SUBCMD_SET_END);

SHELL_STATIC_SUBCMD_SET_CREATE(rgb_readwrite,
                               SHELL_CMD(w, NULL, "Write <R, G, B>", cmd_rgb_write_rgb),
                               SHELL_SUBCMD_SET_END);

SHELL_STATIC_SUBCMD_SET_CREATE(pb_readwrite,
                               SHELL_CMD(r, NULL, "Read", cmd_pb_read_state),
                               SHELL_SUBCMD_SET_END);

SHELL_STATIC_SUBCMD_SET_CREATE(dc_readwrite,
                               SHELL_CMD(w, NULL, "Write the duty cycle <percentage on>", cmd_dc_write_percentage),
                               SHELL_SUBCMD_SET_END);

SHELL_STATIC_SUBCMD_SET_CREATE(sample_readwrite,
                               SHELL_CMD(w, NULL, "Write the sampling time <sec>", cmd_sample_write_sec),
                               SHELL_SUBCMD_SET_END);

SHELL_STATIC_SUBCMD_SET_CREATE(all_control,
                               SHELL_CMD(o, NULL, "Start reading all sensors", cmd_all_on),
                               SHELL_CMD(f, NULL, "Stop reading all sensors", cmd_all_off),
                               SHELL_SUBCMD_SET_END);

// Level 0 //
SHELL_CMD_REGISTER(time, &time_read, "Display elapsed time since power on", cmd_disp_time);
SHELL_CMD_REGISTER(led, NULL, "Control the AHUs LEDs", cmd_led_control);

SHELL_CMD_REGISTER(hts221, &hts221_readwrite, "Temp/Humidity", NULL);
SHELL_CMD_REGISTER(lps22, &lps22_readwrite, "Pressure", NULL);
SHELL_CMD_REGISTER(ccs811, &ccs811_readwrite, "VOC", NULL);
SHELL_CMD_REGISTER(lis2dh, &lis2dh_readwrite, "XYZ Acceleration", NULL);
SHELL_CMD_REGISTER(buzzer, &buzzer_readwrite, "buzzer frequency", NULL);
SHELL_CMD_REGISTER(rgb, &rgb_readwrite, "RGB LED", NULL);
SHELL_CMD_REGISTER(pb, &pb_readwrite, "Pushbutton state (0 or 1)", NULL);
SHELL_CMD_REGISTER(dc, &dc_readwrite, "Duty Cycle", NULL);
SHELL_CMD_REGISTER(sample, &sample_readwrite, "Sample Time", NULL);
SHELL_CMD_REGISTER(all, &all_control, "Toggle Reading All Devices", NULL);
```
