## CMakeLists.txt
```
# SPDX-License-Identifier: Apache-2.0

cmake_minimum_required(VERSION 3.20.0)
find_package(Zephyr REQUIRED HINTS $ENV{ZEPHYR_BASE})
project(peripheral)

include_directories(
                        ../../oslib/scu_drivers/scu_sensors
                        ../../oslib/scu_drivers/scu_ble
                        ../../oslib/scu_drivers/scu_power_management
                        ../../oslib/common/
                        )

target_sources(app PRIVATE
  src/main.c
  ../../oslib/scu_drivers/scu_sensors/scu_sensors.c
  ../../oslib/scu_drivers/scu_ble/scu_ble.c
  ../../oslib/scu_drivers/scu_power_management/scu_power_management.c
  ../../oslib/common/hci_driver.c
)
```

## prj.conf
```kconfig
# Incresed stack due to settings API usage
CONFIG_SYSTEM_WORKQUEUE_STACK_SIZE=2048

#!!Comments next to the configs can cause compilation errors

#CONFIG_BT -> enable bluetooth
#CONFIG_BT_DEBUG_LOG -> bluetooth debug to serial console
#CONFIG_BT_SMP -> security management protocol, for pairing devices over LE
#CONFIG_BT_SIGNING -> for data signing, probably disable this
#CONFIG_BT_PERIPHERAL -> set as peripheral
#CONFIG_BT_DIS -> Enable GATT Device Information service
#CONFIG_BT_ATT_PREPARE_COUNT -> Number of ATT prepare write buffers, 0 disables writes
#CONFIG_BT_BAS -> Enable GATT Batt service
#CONFIG_BT_HRS -> Enable GATT Heart Rate service
#CONFIG_BT_PRIVACY -> This makes it possible to use Resolvable Private Addresses (RPAs).
#CONFIG_BT_DEVICE_NAME -> Bluetooth device name (need to bt_set_name() ?)
#CONFIG_BT_DEVICE_APPEARANCE -> don't touch this
#CONFIG_BT_DEVICE_NAME_DYNAMIC -> allows runtime modification of name
#CONFIG_BT_DEVICE_NAME_MAX -> max byte size for name

CONFIG_BT=y 
CONFIG_BT_DEBUG_LOG=y 
CONFIG_BT_SMP=y 
CONFIG_BT_SIGNING=y 
CONFIG_BT_PERIPHERAL=y 
#CONFIG_BT_DIS=y 
CONFIG_BT_ATT_PREPARE_COUNT=5 
#CONFIG_BT_BAS=y 
#CONFIG_BT_HRS=y 
CONFIG_BT_PRIVACY=y
CONFIG_BT_DEVICE_NAME="AOEUHTNS"
CONFIG_BT_DEVICE_APPEARANCE=833
CONFIG_BT_DEVICE_NAME_DYNAMIC=y
CONFIG_BT_DEVICE_NAME_MAX=65

#CONFIG_BT_KEYS_OVERWRITE_OLDEST -> Overwrite the oldest key if key storage is full (for pairing)
#CONFIG_BT_SETTINGS -> peristent storage of bt settings
#CONFIG_FLASH -> include flash drivers
#CONFIG_FLASH_PAGE_LAYOUT -> flash stuff
#CONFIG_FLASH_MAP -> flash stuff
#CONFIG_NVS -> Enable support of Non-volatile Storage.
#CONFIG_SETTINGS -> don't touch this

CONFIG_BT_KEYS_OVERWRITE_OLDEST=y
CONFIG_BT_SETTINGS=y
CONFIG_FLASH=y
CONFIG_FLASH_PAGE_LAYOUT=y
CONFIG_FLASH_MAP=y
CONFIG_NVS=y
CONFIG_SETTINGS=y

#CONFIG_STDOUT_CONSOLE=y
CONFIG_I2C=y
CONFIG_SENSOR=y
CONFIG_HTS221=y
CONFIG_CCS811=y
CONFIG_LIS2DH=y
CONFIG_LPS22HB=y

#CONFIG_HTS221_TRIGGER_NONE=y
#CONFIG_CBPRINTF_FP_SUPPORT=y

CONFIG_GPIO=y

#######################################
#BT On
CONFIG_BT=y
#Become an observer 
CONFIG_BT_OBSERVER=y
#BT Log Level Debug
CONFIG_BT_DEBUG_LOG=y


#Enable support for the Security Manager Protocol (SMP), making it possible to pair devices over LE.
CONFIG_BT_SMP=y
#Enable data signing which is used for transferring authenticated data in an unencrypted connection.
CONFIG_BT_SIGNING=y
#Select this for LE Central role support
CONFIG_BT_CENTRAL=y
#Enable GATT Device Information service
CONFIG_BT_DIS=y
#Enabled Client procedures 
CONFIG_BT_GATT_CLIENT=y
#Enable local Privacy Feature support. This makes it possible to use Resolvable Private Addresses (RPAs).
CONFIG_BT_PRIVACY=y
#Bluetooth device appearance. 
CONFIG_BT_DEVICE_APPEARANCE=833
CONFIG_BT_FIXED_PASSKEY=y

# Set the BLE to transmit with +4dbm power
CONFIG_BT_CTLR_TX_PWR_PLUS_8=y

CONFIG_BT_CONN_TX_MAX=16
#CONFIG_BT_CTLR_TX_BUFFERS=16

CONFIG_I2C_LOG_LEVEL_DBG=y
CONFIG_LOG=y


CONFIG_USE_SEGGER_RTT=y

CONFIG_RTT_CONSOLE=y
CONFIG_UART_CONSOLE=n

#pwm
CONFIG_PWM=y

#power
CONFIG_PM_DEVICE=y
```

## src/main.c
```c
/**
 * @file main.c
 * @author Jack Mason
 * @date 2022-03-23
 */

#include <zephyr/types.h>
#include <stddef.h>
#include <string.h>
#include <errno.h>
#include <sys/printk.h>
#include <sys/byteorder.h>
#include <zephyr.h>

#include <settings/settings.h>

#include <bluetooth/bluetooth.h>
#include <bluetooth/hci.h>
#include <bluetooth/conn.h>
#include <bluetooth/uuid.h>
#include <bluetooth/gatt.h>
#include <bluetooth/services/bas.h>
#include <bluetooth/services/hrs.h>

#include "scu_sensors.h"
#include "scu_ble.h"
#include "hci_driver.h"

#include <device.h>
//#include <drivers/pwm.h>

//#include <pm/pm.h>
//#include <pm/device.h>
//#include <pm/device_runtime.h>
//#include <pm/state.h>

//set(DTC_OVERLAY_FILE pwm.overlay) //Cmakelists
/*
#if DT_NODE_HAS_STATUS(DT_ALIAS(pwmaudio), okay)
#define PWM_DRIVER  DT_PWMS_CTLR(DT_ALIAS(pwmaudio))
//#define PWM_CHANNEL DT_PWMS_CHANNEL(DT_ALIAS(pwmaudio))
//#define PWM_FLAGS	DT_PWMS_FLAGS(DT_ALIAS(pwmaudio))
#else
#error "Choose a supported PWM driver"
#endif
*/

void main(void)
{
	
	//struct device *pwm_dev;
	//64_t cycles;
	/*
    pwm_dev = device_get_binding(PWM_DRIVER);
    if (!pwm_dev) {
       printk("Cannot find %s!\n", PWM_DRIVER);
       return;
    }  
	//pwm_get_cycles_per_sec(pwm_dev, PWM_CHANNEL, &cycles);
	*/

	/*
	pwm_dev = DEVICE_DT_GET(PWM_DRIVER);
	if (!device_is_ready(pwm_dev)) {
		printk("Error: PWM device %s is not ready\n", pwm_dev->name);
		return;
	}
	*/

	while (1) {
		
		/*
		if (pwm_pin_set_usec(pwm_dev, PWM_CHANNEL, 1000*50, 1000*50 / 2U, PWM_FLAGS)) {
			printk("pwm pin set fails\n");
			//return;
		}

		k_sleep(K_SECONDS(1));
		
		if (pwm_pin_set_usec(pwm_dev, PWM_CHANNEL, 1000*50, 0, PWM_FLAGS)) {
			printk("pwm off fails\n");
			//return;
		}
		*/

		//k_sleep(K_SECONDS(1));
		
	}
}

K_THREAD_DEFINE(ble_base, THREAD_BLE_BASE_STACK, thread_bluetooth, NULL, NULL, NULL, THREAD_PRIORITY_BLE_BASE, 0, 0);
K_THREAD_DEFINE(rx_data, THREAD_BLE_BASE_STACK, thread_data, NULL, NULL, NULL, THREAD_PRIORITY_BLE_BASE, 0, 0);
K_THREAD_DEFINE(continuous, THREAD_BLE_BASE_STACK, thread_continuous, NULL, NULL, NULL, THREAD_PRIORITY_BLE_BASE+1, 0, 0);
```

## src/sens.c
```c
/**
  ******************************************************************************
  * @file   : scu_sensors.c
  * @brief  : 
  ******************************************************************************
  * @author Jack Mason
  * ***************************************************************************
  */

#include <drivers/sensor.h>
#include <device.h>


struct sensor_value temp, humidity; //press,
struct device *mydev1; //= NULL? 

static const struct device *get_hts221_device(void) { 

	const struct device *dev = DEVICE_DT_GET_ANY(st_hts221); //bosch_bme280 


	if (dev == NULL) {

		//No such node, or the node does not have status "okay". 

		//printk("\nError: no device found.\n");

		return NULL;

	}


	if (!device_is_ready(dev)) {

		//printk("\nError: Device \"%s\" is not ready; "

		       //"check the driver initialization logs for errors.\n",

		       //dev->name);

		return NULL;

	}


	//printk("Found device \"%s\", getting sensor data\n", dev->name);

	return dev;

}

const struct device *scu_sensors_init() {

  const struct device *dev = get_hts221_device(); //const struct device 

  if (dev == NULL) {
    ;//return;
  }

  return dev;

}

void scu_sensors_scan(const struct device *dev) {
  
  sensor_sample_fetch(dev);
  sensor_channel_get(dev, SENSOR_CHAN_AMBIENT_TEMP, &temp);
  sensor_channel_get(dev, SENSOR_CHAN_HUMIDITY, &humidity);

}

int scu_sensors_get_temp() {
  return temp.val1;
}

int scu_sensors_get_humidity() {
  return humidity.val1;
}
```

## src/sens.h
```c
/**
  ******************************************************************************
  * @file   : scu_sensors.h
  * @brief  : 
  ******************************************************************************
  * @author Jack Mason
  * ***************************************************************************
  */

#ifndef SCU_SENS_H
#define SCU_SENS_H

#include <device.h>

const struct device *scu_sensors_init();
void scu_sensors_scan(const struct device *dev);
int scu_sensors_get_temp(void);
int scu_sensors_get_humidity(void);

#endif //SCU_SENS_H
```
